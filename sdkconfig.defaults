## sdkconfig.defaults
```kconfig
# =============================================================================
# sdkconfig.defaults — Project-specific defaults for BLE Mesh
# =============================================================================
# This file is committed to git. When a new developer clones the repo,
# `idf.py build` (or `idf.py reconfigure`) will merge these into sdkconfig.
#
# To regenerate sdkconfig from scratch:
#   rm sdkconfig && idf.py reconfigure
#
# To add a new default, append it here and delete sdkconfig to re-merge.
# =============================================================================

# --- Bluetooth ---
CONFIG_BT_ENABLED=y
CONFIG_BT_BLUEDROID_ENABLED=y
CONFIG_BT_BLE_ENABLED=y

# --- BLE Mesh core ---
CONFIG_BLE_MESH=y
CONFIG_BLE_MESH_NODE=y
CONFIG_BLE_MESH_PROVISIONER=y
CONFIG_BLE_MESH_CFG_CLI=y
CONFIG_BLE_MESH_RELAY=y

# --- Flash size (ESP32-WROOM-32E has 4MB) ---
CONFIG_ESPTOOLPY_FLASHSIZE_4MB=y

# --- Partition table (BLE Mesh needs more flash) ---
CONFIG_PARTITION_TABLE_SINGLE_APP_LARGE=y
```
